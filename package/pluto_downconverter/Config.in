## package/pluto_downconverter/Config.in
```kconfig
config BR2_PACKAGE_PLUTO_DOWNCONVERTER
	bool "pluto-downconverter"
	select BR2_PACKAGE_LIBIIO
	help
	  Native PlutoSDR frequency translator built from the workspace src tree.
```

## package/pluto_gpo_ptt/Config.in
```kconfig
config BR2_PACKAGE_PLUTO_GPO_PTT
	bool "pluto-gpo-ptt"
	select BR2_PACKAGE_LIBIIO
	help
	  AD9363 GPO pin control for keying an external PA from the
	  radio's Rx/Tx state. Built from the workspace src tree.
```
